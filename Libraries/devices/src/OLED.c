#include "OLED.h"
#include "gpio.h"

#define X_WIDTH 128
#define Y_WIDTH 64

static uint8_t s_ucGRAM[8][128];
static uint8_t s_ucUpdateEn = 1;

const unsigned char F6x8[][6] = {
    { 0x00, 0x00, 0x00, 0x00, 0x00, 0x00 },   // sp
    { 0x00, 0x00, 0x00, 0x2f, 0x00, 0x00 },   // !
    { 0x00, 0x00, 0x07, 0x00, 0x07, 0x00 },   // "
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    { 0x14, 0x14, 0x14, 0x14, 0x14, 0x14 }    // horiz lines
};

static void OLED_WrDat(uint8_t data);
static void OLED_WrCmd(uint8_t cmd);
static void OLED_Set_Pos(uint8_t x, uint8_t y);
static void OLED_DLY_ms(uint16_t ms);
static void _OLED_PutPixel(uint16_t _usX, uint16_t _usY, uint8_t _ucColor);

void OLED_Init() {
    GPIO_QuickInit(OELD_PORT, OELD_DC_PIN, kGPIO_Mode_OPP);
    GPIO_QuickInit(OELD_PORT, OELD_RST_PIN,kGPIO_Mode_OPP);
    GPIO_QuickInit(OELD_PORT, OELD_SDA_PIN,kGPIO_Mode_OPP);
    GPIO_QuickInit(OELD_PORT, OELD_SCL_PIN,kGPIO_Mode_OPP);

    GPIO_WriteBit(OELD_PORT, OELD_DC_PIN,  0);
    GPIO_WriteBit(OELD_PORT, OELD_RST_PIN, 0);
    GPIO_WriteBit(OELD_PORT, OELD_SDA_PIN, 0);
    GPIO_WriteBit(OELD_PORT, OELD_SCL_PIN, 0);

    OLED_SCL(1);

    OLED_RST(0);
    OLED_DLY_ms(50);
    OLED_RST(1);

    OLED_WrCmd(0xae);//--turn off oled panel
    OLED_WrCmd(0x00);//--set low column address
    OLED_WrCmd(0x10);//--set high column address
    OLED_WrCmd(0x40);//--set start line address: Set Mapping RAM Display Start Line (0x00~0x3F)
    OLED_WrCmd(0x81);//--set contrast control register
    OLED_WrCmd(0xcf); // set SEG Output Current Brightness
    OLED_WrCmd(0xa1);//--set SEG/Column Mapping: 0xa0左右反置 0xa1正常
    OLED_WrCmd(0xc8);//--set COM/Row Scan Direction: 0xc0上下反置 0xc8正常
    OLED_WrCmd(0xa6);//--set normal display
    OLED_WrCmd(0xa8);//--set multiplex ratio(1 to 64)
    OLED_WrCmd(0x3f);//--1/64 duty
    OLED_WrCmd(0xd3);//--set display offset: Shift Mapping RAM Counter (0x00~0x3F)
    OLED_WrCmd(0x00);//--not offset
    OLED_WrCmd(0xd5);//--set display clock divide ratio/oscillator frequency
    OLED_WrCmd(0x80);//--set divide ratio, Set Clock as 100 Frames/Sec
    OLED_WrCmd(0xd9);//--set pre-charge period
    OLED_WrCmd(0xf1);//--set Pre-Charge as 15 Clocks & Discharge as 1 Clock
    OLED_WrCmd(0xda);//--set com pins hardware configuration
    OLED_WrCmd(0x12);
    OLED_WrCmd(0xdb);//--set vcomh
    OLED_WrCmd(0x40);//--set VCOM Deselect Level
    OLED_WrCmd(0x20);//--set Page Addressing Mode (0x00/0x01/0x02)
    OLED_WrCmd(0x02);//
    OLED_WrCmd(0x8d);//--set Charge Pump enable/disable
    OLED_WrCmd(0x14);//--set(0x10) disable
    OLED_WrCmd(0xa4);//--disable Entire Display On (0xa4/0xa5)
    OLED_WrCmd(0xa6);//--disable Inverse Display On (0xa6/a7)
    OLED_WrCmd(0xaf);//--turn on oled panel

    OLED_CLS();
    OLED_Set_Pos(0,0);
}

void OLED_Fill(uint8_t bmp_data) {
    uint8_t y, x;

    for(y = 0; y < 8; ++y) {
        OLED_WrCmd(0xb0 + y);
        OLED_WrCmd(0x01);
        OLED_WrCmd(0x10);
        for(x=0; x < X_WIDTH; ++x)
            OLED_WrDat(bmp_data);
    }
}

void OLED_PutPixel(uint8_t x, uint8_t y) {
    uint8_t data;

    OLED_Set_Pos(x, (uint8_t)(y >> 3));
    data =(uint8_t)(0x01 << (y % 8));
    OLED_WrCmd((uint8_t)(0xb0 + (y >> 3)));
    OLED_WrCmd((uint8_t)(((x & 0xf0) >> 4) | 0x10));
    OLED_WrCmd((uint8_t)((x & 0x0f) | 0x00));
    OLED_WrDat(data);
}

void OLED_Rectangle(uint8_t x1, uint8_t y1, uint8_t x2, uint8_t y2, uint8_t gif) {
    uint8_t n;

    OLED_Set_Pos(x1, y1 >> 3);
    for(n = x1; n <= x2; ++n) {
        OLED_WrDat(0x01 << (y1 % 8));
        if(gif == 1)
            OLED_DLY_ms(50);
    }
    
    OLED_Set_Pos(x1, y2 >> 3);
    for(n = x1; n <= x2; ++n) {
        OLED_WrDat(0x01 << (y2 % 8));
        if(gif == 1)
            OLED_DLY_ms(5);
    }
}

void OLED_DrawBMP(uint8_t x0, uint8_t y0, uint8_t x1, uint8_t y1, uint8_t *bmp) {
    uint16_t ii = 0;
    uint8_t x, y;
    
    y = y1 / 8 + !!(y1 % 8);
    for(y = y0; y <= y1; ++y) {
        OLED_Set_Pos(x0, y);
        for(x = x0; x < x1; ++x) {
            OLED_WrDat(bmp[ii++]);
        }
    }
}

void OLED_DrawCircle(uint16_t _usX, uint16_t _usY, uint16_t _usRadius, uint8_t _ucColor) {
    int32_t D;            /* Decision Variable */
    uint32_t CurX;        /* 当前 X 值 */
    uint32_t CurY;        /* 当前 Y 值 */

    D = 3 - (_usRadius << 1);
    CurX = 0;
    CurY = _usRadius;

    while (CurX <= CurY) {
        _OLED_PutPixel(_usX + CurX, _usY + CurY, _ucColor);
        _OLED_PutPixel(_usX + CurX, _usY - CurY, _ucColor);
        _OLED_PutPixel(_usX - CurX, _usY + CurY, _ucColor);
        _OLED_PutPixel(_usX - CurX, _usY - CurY, _ucColor);
        _OLED_PutPixel(_usX + CurY, _usY + CurX, _ucColor);
        _OLED_PutPixel(_usX + CurY, _usY - CurX, _ucColor);
        _OLED_PutPixel(_usX - CurY, _usY + CurX, _ucColor);
        _OLED_PutPixel(_usX - CurY, _usY - CurX, _ucColor);

        if (D < 0) {
            D += (CurX << 2) + 6;
        } else {
            D += ((CurX - CurY) << 2) + 10;
            --CurY;
        }
        ++CurX;
    }
}

void OLED_P6x8Str(uint8_t x, uint8_t y, uint8_t ch[]) {
    uint8_t c = 0, i = 0, j = 0;

    while(ch[j]) {
        c = ch[j] - 32;
        if(x > 126) {
            x = 0;
            ++y;
        }
        OLED_Set_Pos(x, y);
        for(i = 0; i < 6; ++i)
            OLED_WrDat(F6x8[c][i]);
        x+=6;
        ++j;
    }
}

void OLED_P6x8Num(uint8_t x, uint8_t y, uint16_t num) {
    uint8_t ch[5] = { 0 };
    
    ch[4] = num % 10 + 48;
    ch[3] = num / 10 % 10 + 48;
    ch[2] = num / 100 % 10 + 48;
    ch[1] = num / 1000 % 10 + 48;
    ch[0] = num / 10000 % 10 + 48;
    
    OLED_P6x8Str(x, y, ch);
}

void OLED_WrDat(uint8_t data) {
    uint8_t i = 8;
    OLED_DC(1);;
    OLED_SCL(0);;
    while(i--) {
        if(data & 0x80) { OLED_SDA(1); }
        else { OLED_SDA(0); }
        OLED_SCL(1);
        OLED_SCL(0);;
        data <<= 1;
    }
}

void OLED_WrCmd(uint8_t cmd) {
    uint8_t i = 8;
    OLED_DC(0);;
    OLED_SCL(0);;
    while(i--) {
        if(cmd & 0x80) { OLED_SDA(1); }
        else { OLED_SDA(0);; }
        OLED_SCL(1);;
        OLED_SCL(0);;
        cmd <<= 1;;
    }
}

void OLED_Set_Pos(uint8_t x, uint8_t y) {
    OLED_WrCmd(0xb0 + y);
    OLED_WrCmd(((x & 0xf0) >> 4) | 0x10);
    OLED_WrCmd((x & 0x0f) | 0x01);
}

void OLED_DLY_ms(uint16_t ms) {
    uint16_t a;

    while(ms) {
        a = 1335;
        while(a--);
        --ms;
    }
}

void _OLED_PutPixel(uint16_t _usX, uint16_t _usY, uint8_t _ucColor) {
    uint8_t ucValue;
    uint8_t ucPageAddr;
    uint8_t ucColAddr;
    const uint8_t aOrTab[8]  = { 0x01, 0x02, 0x04, 0x08, 0x10, 0x20, 0x40, 0x80 };
    const uint8_t aAndTab[8] = { 0xFE, 0xFD, 0xFB, 0xF7, 0xEF, 0xDF, 0xBF, 0x7F };

    ucPageAddr = _usY / 8;
    ucColAddr = 127 - _usX;

    ucValue = s_ucGRAM[ucPageAddr][ucColAddr];
    
    if (_ucColor == 0) {
        ucValue &= aAndTab[_usY % 8];
    } else {
        ucValue |= aOrTab[_usY % 8];
    }
    
    s_ucGRAM[ucPageAddr][ucColAddr] = ucValue;
    
    if (s_ucUpdateEn == 1) {
        OLED_WrCmd (0xB0 + ucPageAddr);                   /* 设置页地址（0~7）  */
        OLED_WrCmd (0x00 + (ucColAddr & 0x0F));           /* 设置列地址的低地址 */
        OLED_WrCmd (0x10 + ((ucColAddr >> 4) & 0x0F));    /* 设置列地址的高地址 */
        OLED_WrDat(ucValue);
    }
}
